// Note from Reddit:
//   - I'm on ZMK, and I have shift set to balanced, tapping term 50ms,
//     and the rest of my mods set to tap-preferred, with a tapping term of 250ms.

#define MHT(MOD, TAP) &mht MOD TAP
#define LHT(LAYER, TAP) &lht LAYER TAP
#define LT_BDEL(LAYER) &lt_bdel LAYER 0
#define LT_KRPT(LAYER) &lt_krpt LAYER 0

#define SHIFT_BEHAVIOUR(NAME, BINDING, SHIFT_BINDING) \
/ { \
    behaviors { \
        NAME: NAME { \
            compatible = "zmk,behavior-mod-morph"; \
            #binding-cells = <0>; \
            bindings = <BINDING>, <SHIFT_BINDING>; \
            mods = <(MOD_LSFT|MOD_RSFT)>; \
        }; \
    }; \
};

#define BT_SHIFT_BEHAVIOUR(NUM) \
SHIFT_BEHAVIOUR(bt_sel_##NUM, &bt BT_SEL NUM, &bt_sel_clr NUM)

BT_SHIFT_BEHAVIOUR(0)
BT_SHIFT_BEHAVIOUR(1)
BT_SHIFT_BEHAVIOUR(2)
BT_SHIFT_BEHAVIOUR(3)
BT_SHIFT_BEHAVIOUR(4)

SHIFT_BEHAVIOUR(out_tog, &out OUT_TOG, &out OUT_USB)
SHIFT_BEHAVIOUR(_caps_word, &caps_word, &kp CAPS)

&caps_word {
    continue-list = <UNDERSCORE MINUS BACKSPACE DELETE>;
};

/ {
    behaviors {
        mht: mht {
            compatible = "zmk,behavior-hold-tap";
            #binding-cells = <2>;
            tapping-term-ms = <TAPPING_TERM>;
            flavor = "tap-preferred";
            bindings = <&kp>, <&kp>;
        };
        lht: lht {
            compatible = "zmk,behavior-hold-tap";
            #binding-cells = <2>;
            tapping-term-ms = <TAPPING_TERM>;
            flavor = "tap-preferred";
            bindings = <&mo>, <&kp>;
        };
        bspc_del: backspace_delete {
            compatible = "zmk,behavior-mod-morph";
            #binding-cells = <0>;
            bindings = <&kp BACKSPACE>, <&kp DELETE>;
            mods = <(MOD_LSFT|MOD_RSFT)>;
            keep-mods = <(MOD_RSFT)>;
        };
        lt_bdel: lt_backspace_delete {
            compatible = "zmk,behavior-hold-tap";
            #binding-cells = <2>;
            tapping-term-ms = <TAPPING_TERM>;
            flavor = "tap-preferred";
            bindings = <&mo>, <&bspc_del>;
        };
        lt_krpt: lt_key_repeat {
            compatible = "zmk,behavior-hold-tap";
            #binding-cells = <2>;
            tapping-term-ms = <TAPPING_TERM>;
            flavor = "tap-preferred";
            bindings = <&mo>, <&key_repeat>;
        };
    };
};
