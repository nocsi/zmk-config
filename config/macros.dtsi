/ {
    macros {
        /**
         * Switch to and clear the given Bluetooth profile.
         *
         * Params:
         *  1. Bluetooth profile number
         *
         * Example:
         *  `&bt_sel_clr 0`
         */
        bt_sel_clr: bt_sel_clr {
            compatible = "zmk,behavior-macro-one-param";
            label = "ZM_BT_SEL_CLR";
            wait-ms = <0>;
            #binding-cells = <1>;
            bindings
                = <&macro_param_1to2>
                , <&bt BT_SEL MACRO_PLACEHOLDER>
                , <&bt BT_CLR>
                ;
        };
    };
};
