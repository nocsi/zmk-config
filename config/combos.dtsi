//                           Key Positions
// ╭────┬────┬────┬────┬────╮   ╭────┬────┬────┬────┬────╮
//   00   01   02   03   04       05   06   07   08   09
// ├────┼────┼────┼────┼────┤   ├────┼────┼────┼────┼────┤
//   10   11   12   13   14       15   16   17   18   19
// ├────┼────┼────┼────┼────┤   ├────┼────┼────┼────┼────┤
//   20   21   22   23   24       25   26   27   28   29
// ╰────┴────┼────┼────┼────┤   ├────┼────┼────┼────┴────╯
//             30   31   32       33   34   35
//           ╰────┴────┴────╯   ╰────┴────┴────╯

/ {
    combos {
        compatible = "zmk,combos";
        /**
         * Place `Q` on lower right pinkie/ring fingers.
         */
        combo_q {
            key-positions = <28 29>;
            bindings = <&kp Q>;
            layers = <BASE>;
        };
        /**
         * Place `Z` on lower left pinkie/ring fingers.
         */
        combo_z {
            key-positions = <20 21>;
            bindings = <&kp Z>;
            layers = <BASE>;
        };
    };
};
